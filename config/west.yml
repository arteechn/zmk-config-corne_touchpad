## config/west.yml
```yaml
manifest:
  remotes:
  - name: zmkfirmware
    url-base: https://github.com/zmkfirmware
    # Additional modules containing boards/shields/custom code can be listed here as well
    # See https://docs.zephyrproject.org/3.2.0/develop/west/manifest.html#projects
    - name: oleksandrmaslov
    url-base: https://github.com/oleksandrmaslov  
  projects:
  - name: zmk
    remote: zmkfirmware
    revision: v0.3
    import: app/west.yml
  - name: cirque-input-module
    url: https://github.com/petejohanson/cirque-input-module
    revision: main
    path: modules/cirque-input-module
  - name: zmk-pointing-acceleration
    remote: oleksandrmaslov
    revision: main
  self:
    path: config
```
